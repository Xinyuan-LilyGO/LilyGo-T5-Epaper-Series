
#include <SD.h>
#include <SPI.h>
#include <Button2.h>
#include <GxEPD2_3C.h>          //GxEPD2  https://github.com/ZinggJM/GxEPD2
#include <Fonts/FreeMonoBold9pt7b.h>
#include <Fonts/FreeMonoBold12pt7b.h>
#include <Fonts/FreeMonoBold18pt7b.h>
#include <Fonts/FreeMonoBold24pt7b.h>


#define ELINK_BUSY 4
#define ELINK_RESET 16
#define ELINK_DC 17
#define ELINK_SS 5

#define SPI_MOSI 23
#define SPI_MISO -1 //elink no use
#define SPI_CLK 18

#define SDCARD_SS 13
#define SDCARD_MOSI 15
#define SDCARD_MISO 2
#define SDCARD_CLK 14

#define BUTTON_1 37
#define BUTTON_2 38
#define BUTTON_3 39

#define SPEAKER_OUT 25
#define AMP_POWER_CTRL 19
#define CHANNEL_0 0
#define BUTTONS_MAP \
    {               \
        37, 38, 39  \
    }

GxEPD2_3C<GxEPD2_154_Z90c, GxEPD2_154_Z90c::HEIGHT> display(GxEPD2_154_Z90c(
            /*CS*/ ELINK_SS, /*DC*/ ELINK_DC, /*RST*/ ELINK_RESET, /*BUSY*/ ELINK_BUSY)); // GDEH0154Z90


//width:150,height:39
int bmpWidth = 150, bmpHeight = 39;
const unsigned char lilygo[] = {0x00, 0x00, 0x00, 0x00, 0x00, 0x00, 0x00, 0x00, 0x00, 0x00, 0x00, 0x00, 0x00,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 0x00, 0x00};

const char *skuNum = "SKU:H215";
int startX = 30, startY = 50;

Button2 *pBtns = nullptr;
SPIClass SDSPI(VSPI);
uint8_t g_btns[] = BUTTONS_MAP;
bool sdOK = false;


void button_callback(Button2 &b)
{
    for (int i = 0; i < sizeof(g_btns) / sizeof(g_btns[0]); ++i) {
        if (pBtns[i] == b) {
            Serial.printf("Button: %u Press\n", pBtns[i].getAttachPin());
            ledcWriteTone(CHANNEL_0, 1000);
            delay(200);
            ledcWriteTone(CHANNEL_0, 0);
        }
    }
}

void button_init()
{
    uint8_t args = sizeof(g_btns) / sizeof(g_btns[0]);
    pBtns = new Button2[args];
    for (int i = 0; i < args; ++i) {
        pBtns[i] = Button2(g_btns[i]);
        pBtns[i].setPressedHandler(button_callback);
    }
}


void setup()
{
    Serial.begin(115200);

    Serial.println();

    Serial.println("setup");

    SPI.begin(SPI_CLK, SPI_MISO, SPI_MOSI);

    display.init(); // enable diagnostic output on Serial

    //Serial.println("helloWorld");
    display.setRotation(1);
    display.setFont(&FreeMonoBold9pt7b);
    display.setTextColor(GxEPD_BLACK);
    int16_t tbx, tby; uint16_t tbw, tbh;
    display.getTextBounds("HelloWorld", 0, 0, &tbx, &tby, &tbw, &tbh);
    // center bounding box by transposition of origin:
    uint16_t x = ((display.width() - tbw) / 2) - tbx;
    uint16_t y = ((display.height() - tbh) / 2) - tby;
    display.setFullWindow();
    display.firstPage();
    do {
        display.fillScreen(GxEPD_WHITE);
        display.setCursor(x, y);
        display.print("HelloWorld");
    } while (display.nextPage());
    //Serial.println("helloWorld done");


    pinMode(AMP_POWER_CTRL, OUTPUT);
    digitalWrite(AMP_POWER_CTRL, HIGH);

    ledcSetup(CHANNEL_0, 1000, 8);
    ledcAttachPin(SPEAKER_OUT, CHANNEL_0);
    int i = 3;
    while (i--) {
        ledcWriteTone(CHANNEL_0, 1000);
        delay(200);
        ledcWriteTone(CHANNEL_0, 0);
    }

    button_init();

    display.setRotation(1);
    display.fillScreen(GxEPD_WHITE);
    display.setTextColor(GxEPD_BLACK);
    display.setFont(&FreeMonoBold9pt7b);
    display.setCursor(0, 0);

    SDSPI.begin(SDCARD_CLK, SDCARD_MISO, SDCARD_MOSI, SDCARD_SS);

    if (!SD.begin(SDCARD_SS, SDSPI)) {
        sdOK = false;
    } else {
        sdOK = true;
    }

    display.setFullWindow();
    display.firstPage();
    do {
        display.fillScreen(GxEPD_WHITE);
        display.drawBitmap(startX, startY,  lilygo, bmpWidth, bmpHeight, GxEPD_RED);
        display.setCursor(display.width()   / 2 - 40, display.height() - 10);
#if defined(HAS_RED_COLOR)
        display.setTextColor(GxEPD_RED);
#endif
        display.setCursor(display.width()  - display.width() / 2, display.height() - 35);
        display.println(skuNum);
        display.setTextColor(GxEPD_BLACK);
        if (sdOK) {
            uint32_t cardSize = SD.cardSize() / (1024 * 1024);
            display.println("SDCard:" + String(cardSize) + "MB");
        } else {
            display.println("SDCard  None");
        }
    } while (display.nextPage());

}


void loop()
{
    for (int i = 0; i < sizeof(g_btns) / sizeof(g_btns[0]); ++i) {
        pBtns[i].loop();
    }
}
