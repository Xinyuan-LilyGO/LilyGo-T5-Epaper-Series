// include library, include base class, make path known
#include <GxEPD.h>
#include "SD.h"
#include "SPI.h"
#include <Button2.h>

// select the display class to use, only one
// #include <GxGDEP015OC1/GxGDEP015OC1.h>    // 1.54" b/w               //G702-A
// #include <GxGDEW0154Z04/GxGDEW0154Z04.h>  // 1.54" b/w/r 200x200        //H215
// #include <GxGDEW0154Z17/GxGDEW0154Z17.h>  // 1.54" b/w/r 152x152     //H222

// #include <GxGDE0213B1/GxGDE0213B1.h>      // 2.13" b/w               //G702-B
// #include <GxGDEW0213Z16/GxGDEW0213Z16.h>  // 2.13" b/w/r             //H219
// #include <GxGDE0213B72/GxGDE0213B72.h>       // 2.13" b/w
// #include <GxGDE0213B72B/GxGDE0213B72B.h>       // 2.13" b/w

// #include <GxGDEH029A1/GxGDEH029A1.h>      // 2.9" b/w                //G702-C
// #include <GxGDEW029T5/GxGDEW029T5.h>      // 2.9" b/w IL0373
// #include <GxGDEW029Z10/GxGDEW029Z10.h>    // 2.9" b/w/r              //H224 YBW

// #include <GxGDEW027C44/GxGDEW027C44.h>    // 2.7" b/w/r                 //H220
// #include <GxGDEW027W3/GxGDEW027W3.h>      // 2.7" b/w                //H225

//#include <GxGDEW042T2/GxGDEW042T2.h>      // 4.2" b/w
//#include <GxGDEW042Z15/GxGDEW042Z15.h>    // 4.2" b/w/r
//#include <GxGDEW0583T7/GxGDEW0583T7.h>    // 5.83" b/w
//#include <GxGDEW075T8/GxGDEW075T8.h>      // 7.5" b/w
//#include <GxGDEW075Z09/GxGDEW075Z09.h>    // 7.5" b/w/r


#if   defined(_GxGDEW0154Z04_H_) ||defined(_GxGDEW0154Z17_H_) || defined(_GxGDEW0213Z16_H_) || defined(_GxGDE0213B72_H_) ||  defined(_GxGDE0213B72B_H_) || defined(_GxGDEP015OC1_H_)
int bmpWidth = 150, bmpHeight = 39;
//width:150,height:39
const unsigned char lilygo[] = {0x00, 0x00, 0x00, 0x00, 0x00, 0x00, 0x00, 0x00, 0x00, 0x00, 0x00, 0x00, 0x00,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 0x00, 0x00};
#elif defined(_GxGDEW027C44_H_) || defined(_GxGDEW027W3_H_) || defined(_GxGDEH029A1_H_) || defined(_GxGDEW029Z10_H_)
int bmpWidth = 230, bmpHeight = 60;
//width:230,height:60
const unsigned char lilygo[] U8X8_PROGMEM = {0x00, 0x00, 0x00, 0x00, 0x00, 0x00, 0x00, 0x00, 0x00, 0x00, 0x00, 0x00, 0x00,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 0x00, 0x00};
#endif

#if   defined(_GxGDEW0154Z04_H_)
const char *skuNum = "SKU:H215";
int startX = 30, startY = 50;
#elif defined(_GxGDEP015OC1_H_)
const char *skuNum = "SKU:G702-A";
int startX = 30, startY = 50;
#elif defined(_GxGDEW027W3_H_)
const char *skuNum = "SKU:H225";
int startX = 30, startY = 50;
#elif defined(_GxGDEW0154Z17_H_)
const char *skuNum = "SKU:H222";
#define HAS_RED_COLOR
int startX = 5, startY = 50;
#elif defined(_GxGDEW0213Z16_H_)
const char *skuNum = "SKU:H219";
int startX = 40, startY = 10;
#elif defined(_GxGDEH029A1_H_)
const char *skuNum = "SKU:G702-C";
int startX = 30, startY = 10;
#elif defined(_GxGDEW029Z10_H_)
// const char *skuNum = "SKU:H224";
 const char *skuNum = "SKU:H221";
int startX = 30, startY = 10;
#elif defined(_GxGDEW027C44_H_)
const char *skuNum = "SKU:H220";
int startX = 30, startY = 50;
#elif defined(_GxGDE0213B72_H_)
const char *skuNum = "SKU:None";
int startX = 40, startY = 10;
#elif defined(_GxGDE0213B72B_H_)
const char *skuNum = "SKU:G702-B";
int startX = 40, startY = 10;
#elif defined(_GxGDEW042Z15_H_)
const char *skuNum = "";
#elif defined(_GxGDEW075Z09_H_)
const char *skuNum = "";
#else

#endif


// FreeFonts from Adafruit_GFX
#include <Fonts/FreeMonoBold9pt7b.h>
#include <Fonts/FreeMonoBold12pt7b.h>
#include <Fonts/FreeMonoBold18pt7b.h>
#include <Fonts/FreeMonoBold24pt7b.h>


#include <GxIO/GxIO_SPI/GxIO_SPI.h>
#include <GxIO/GxIO.h>

#define ELINK_BUSY 4
#define ELINK_RESET 16
#define ELINK_DC 17
#define ELINK_SS 5

#define SPI_MOSI 23
#define SPI_MISO -1 //elink no use
#define SPI_CLK 18

#define SDCARD_SS 13
#define SDCARD_MOSI 15
#define SDCARD_MISO 2
#define SDCARD_CLK 14

#define BUTTON_1 37
#define BUTTON_2 38
#define BUTTON_3 39

#define SPEAKER_OUT 25
#define AMP_POWER_CTRL 19
#define CHANNEL_0 0
#define BUTTONS_MAP \
    {               \
        37, 38, 39  \
    }

Button2 *pBtns = nullptr;
uint8_t g_btns[] = BUTTONS_MAP;

GxIO_Class io(SPI, /*CS=5*/ ELINK_SS, /*DC=*/ ELINK_DC, /*RST=*/ ELINK_RESET); // arbitrary selection of 17, 16
GxEPD_Class display(io, /*RST=*/ ELINK_RESET, /*BUSY=*/ ELINK_BUSY); // arbitrary selection of (16), 4


#if defined(_GxGDEW0154Z04_H_) || defined(_GxGDEW0213Z16_H_) || defined(_GxGDEW029Z10_H_) || defined(_GxGDEW027C44_H_) || defined(_GxGDEW042Z15_H_) || defined(_GxGDEW075Z09_H_)
#define HAS_RED_COLOR
#endif


void button_callback(Button2 &b)
{
    for (int i = 0; i < sizeof(g_btns) / sizeof(g_btns[0]); ++i) {
        if (pBtns[i] == b) {
            Serial.printf("Button: %u Press\n", pBtns[i].getAttachPin());
            ledcWriteTone(CHANNEL_0, 1000);
            delay(200);
            ledcWriteTone(CHANNEL_0, 0);
        }
    }
}

void button_init()
{
    uint8_t args = sizeof(g_btns) / sizeof(g_btns[0]);
    pBtns = new Button2[args];
    for (int i = 0; i < args; ++i) {
        pBtns[i] = Button2(g_btns[i]);
        pBtns[i].setPressedHandler(button_callback);
    }
}

bool sdOK = false;

void setup()
{
    Serial.begin(115200);
    Serial.println();
    Serial.println("setup");
    SPI.begin(SPI_CLK, SPI_MISO, SPI_MOSI, ELINK_SS);
    display.init(); // enable diagnostic output on Serial


    pinMode(AMP_POWER_CTRL, OUTPUT);
    digitalWrite(AMP_POWER_CTRL, HIGH);

    ledcSetup(CHANNEL_0, 1000, 8);
    ledcAttachPin(SPEAKER_OUT, CHANNEL_0);
    int i = 3;
    while (i--) {
        ledcWriteTone(CHANNEL_0, 1000);
        delay(200);
        ledcWriteTone(CHANNEL_0, 0);
    }


    button_init();

    display.setRotation(1);
    display.fillScreen(GxEPD_WHITE);
    display.setTextColor(GxEPD_BLACK);
    display.setFont(&FreeMonoBold9pt7b);
    display.setCursor(0, 0);

    SPIClass sdSPI(VSPI);
    sdSPI.begin(SDCARD_CLK, SDCARD_MISO, SDCARD_MOSI, SDCARD_SS);

    if (!SD.begin(SDCARD_SS, sdSPI)) {
        sdOK = false;
    } else {
        sdOK = true;
    }


    display.fillScreen(GxEPD_WHITE);
#if defined(HAS_RED_COLOR)
    display.drawBitmap(lilygo, startX, startY,  bmpWidth, bmpHeight, GxEPD_RED);
#else

#if defined(_GxGDEH029A1_H_)|| defined(_GxGDE0213B72_H_) ||  defined(_GxGDE0213B72B_H_) || defined(_GxGDEP015OC1_H_)
    display.drawBitmap(lilygo, startX, startY,  bmpWidth, bmpHeight, GxEPD_BLACK);
#elif defined(_GxGDEW027W3_H_)
    display.drawBitmap(lilygo, startX, startY,  bmpWidth, bmpHeight, GxEPD_WHITE);
#endif
#endif




#if   defined(_GxGDEW0154Z04_H_) || defined(_GxGDEW027W3_H_) || defined(_GxGDEW0213Z16_H_) || defined(_GxGDE0213B72_H_) ||  defined(_GxGDE0213B72B_H_)
    display.setCursor(display.width()  - display.width() / 2, display.height() - 35);
#elif defined(_GxGDEP015OC1_H_)
    display.setCursor(display.width()  - display.width() / 2 - 10, display.height() - 35);
#elif defined(_GxGDEW027C44_H_) || defined(_GxGDEH029A1_H_) || defined(_GxGDEW029Z10_H_)
    display.setCursor(display.width()  - display.width() / 2 - 20, display.height() - 35);
#else
#error "eee"
#endif


#if defined(HAS_RED_COLOR)
    display.setTextColor(GxEPD_RED);
#endif
    display.println(skuNum);

    display.setTextColor(GxEPD_BLACK);

#if   defined(_GxGDEW0154Z04_H_) || defined(_GxGDEW027W3_H_) || defined(_GxGDEW0213Z16_H_) || defined(_GxGDE0213B72_H_) ||  defined(_GxGDE0213B72B_H_) || defined(_GxGDEP015OC1_H_)
    display.setCursor(display.width()   / 2 - 40, display.height() - 10);
#elif defined(_GxGDEW027C44_H_) || defined(_GxGDEH029A1_H_) || defined(_GxGDEW029Z10_H_)
    display.setCursor(display.width()   / 2 - 60, display.height() - 10);
#else
#error "eee"
#endif


    if (sdOK) {
        uint32_t cardSize = SD.cardSize() / (1024 * 1024);
        display.println("SDCard:" + String(cardSize) + "MB");
    } else {
        display.println("SDCard  None");
    }
    display.update();
}


void loop()
{
    for (int i = 0; i < sizeof(g_btns) / sizeof(g_btns[0]); ++i) {
        pBtns[i].loop();
    }
}
