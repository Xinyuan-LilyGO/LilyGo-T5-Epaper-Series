#include "SD.h"
#include "SPI.h"
#include <GxEPD.h>
#include <GxIO/GxIO_SPI/GxIO_SPI.h>
#include <GxIO/GxIO.h>

#include <GxGDEH029A1/GxGDEH029A1.h> // 2.9" b/w

// FreeFonts from Adafruit_GFX
#include <Fonts/FreeMonoBold9pt7b.h>
#include <Fonts/FreeMonoBold12pt7b.h>
#include <Fonts/FreeMonoBold18pt7b.h>
#include <Fonts/FreeMonoBold24pt7b.h>

int bmpWidth = 230, bmpHeight = 60;
//width:230,height:60
const unsigned char lilygo[] = {0x00, 0x00, 0x00, 0x00, 0x00, 0x00, 0x00, 0x00, 0x00, 0x00, 0x00, 0x00, 0x00,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 0x00, 0x00};

const char *skuNum = "SKU:208";
int startX = 30, startY = 10;

#define SPI_MOSI        23
#define SPI_MISO        2
#define SPI_CLK         18

#define ELINK_SS        5
#define ELINK_BUSY      4
#define ELINK_RESET     12
#define ELINK_DC        19

#define SDCARD_SS       13

#define BUTTON_1        37
#define BUTTON_2        38
#define BUTTON_3        39

#define SPEAKER_OUT     25

GxIO_Class io(SPI, ELINK_SS, ELINK_DC, ELINK_RESET);
GxEPD_Class display(io, ELINK_RESET, ELINK_BUSY);
// SPIClass sdSPI(VSPI);


bool sdOK = false;

void setup()
{
    pinMode(BUTTON_1, INPUT);
    pinMode(BUTTON_2, INPUT);
    pinMode(BUTTON_3, INPUT);

    Serial.begin(115200);

    ledcSetup(0, 1000, 8);
    ledcAttachPin(SPEAKER_OUT, 0);
    int i = 3;
    while (i--) {
        ledcWriteTone(0, 1000);
        delay(200);
        ledcWriteTone(0, 0);
    }

    SPI.begin(SPI_CLK, SPI_MISO, SPI_MOSI, ELINK_SS);
    display.init(); // enable diagnostic output on Serial
    display.setRotation(1);
    display.fillScreen(GxEPD_WHITE);
    display.setTextColor(GxEPD_BLACK);
    display.setFont(&FreeMonoBold9pt7b);
    display.setCursor(0, 0);

    // sdSPI.begin(SDCARD_CLK, SDCARD_MISO, SDCARD_MOSI, SDCARD_SS);
    if (!SD.begin(SDCARD_SS/*, sdSPI*/)) {
        sdOK = false;
    } else {
        sdOK = true;
    }

    display.drawBitmap(lilygo, startX, startY,  bmpWidth, bmpHeight, GxEPD_BLACK);
    display.setCursor(display.width()  - display.width() / 2 - 20, display.height() - 35);

#if defined(HAS_RED_COLOR)
    display.setTextColor(GxEPD_RED);
#endif
    display.println(skuNum);

    display.setTextColor(GxEPD_BLACK);

    display.setCursor(display.width()   / 2 - 60, display.height() - 10);

    if (sdOK) {
        uint32_t cardSize = SD.cardSize() / (1024 * 1024);
        display.println("SDCard:" + String(cardSize) + "MB");
    } else {
        display.println("SDCard  None");
    }
    display.update();
}

void loop()
{
    if (digitalRead(BUTTON_1) == LOW) {
        display.update(); delay(500);
    } else if (digitalRead(BUTTON_2) == LOW) {
        display.update(); delay(500);
    } else if (digitalRead(BUTTON_3) == LOW) {
        esp_sleep_enable_ext0_wakeup((gpio_num_t )BUTTON_3, LOW);
        esp_deep_sleep_start();
    }
}